## CMakeLists.txt
```
# SPDX-License-Identifier: Apache-2.0

cmake_minimum_required(VERSION 3.20.0)
find_package(Zephyr REQUIRED HINTS $ENV{ZEPHYR_BASE})
project(blinky)

file(GLOB SRC "${CMAKE_CURRENT_SOURCE_DIR}/src/*.c")


target_sources(app PRIVATE ${SRC})
```

## prj.conf
```kconfig
CONFIG_GPIO=y
CONFIG_LOG=y
CONFIG_LOG_THREAD_ID_PREFIX=y
CONFIG_LOG_BACKEND_UART_ASYNC=y
CONFIG_TRACING=y

CONFIG_UART_ASYNC_API=y

#USE IN GDB: 
#dump binary value build/trace.bin *RecorderDataPtr
CONFIG_PERCEPIO_TRACERECORDER=y
CONFIG_PERCEPIO_TRC_CFG_STREAM_PORT_RINGBUFFER=y
CONFIG_PERCEPIO_TRC_CFG_STREAM_PORT_RINGBUFFER_SIZE=65536
```

## boards/nucleo_f411re.overlay
```dts
&dma1 {
    status="okay";
};
&dma2 {
    status="okay";
};

&usart2 {
	dmas = <&dma1 6 4 (STM32_DMA_PERIPH_TX) STM32_DMA_FIFO_FULL
		&dma1 5 4 (STM32_DMA_MODE_CYCLIC | STM32_DMA_PERIPH_RX | STM32_DMA_MEM_8BITS) STM32_DMA_FIFO_FULL>;
	dma-names = "tx", "rx";
	fifo-enable;
};
```

## src/main.c
```c
/*
 * Copyright (c) 2016 Intel Corporation
 *
 * SPDX-License-Identifier: Apache-2.0
 */

 #include <stdio.h>
 #include <zephyr/kernel.h>
 #include <zephyr/drivers/gpio.h>
 

 #include "zephyr/logging/log.h"
 
LOG_MODULE_REGISTER(main);

/* 1000 msec = 1 sec */
#define SLEEP_TIME_MS   1000

/* The devicetree node identifier for the "led0" alias. */
#define LED0_NODE DT_ALIAS(led0)

/*
 * A build error on this line means your board is unsupported.
 * See the sample documentation for information on how to fix this.
 */
static const struct gpio_dt_spec led = GPIO_DT_SPEC_GET(LED0_NODE, gpios);

int main(void)
{
	int ret;
	bool led_state = true;

	if (!gpio_is_ready_dt(&led)) {
		return 0;
	}

	ret = gpio_pin_configure_dt(&led, GPIO_OUTPUT_ACTIVE);
	if (ret < 0) {
		return 0;
	}


    extern int32_t led_send();
    extern int32_t adc_send();
	while (1) {
        ret = gpio_pin_toggle_dt(&led);
		if (ret < 0) {
            return 0;
		}
        
		led_state = !led_state;
		LOG_INF("LED state: %s\n", led_state ? "ON" : "OFF");
        led_send();
        adc_send();
		k_msleep(SLEEP_TIME_MS);
	}
	return 0;
}
```

## src/adc_loop.c
```c
#include "zephyr/sys/clock.h"
#include <stdlib.h>
#include <sys/_stdint.h>
#include <sys/errno.h>
#include <zephyr/kernel.h>


#include <zephyr/logging/log.h>

LOG_MODULE_REGISTER(adc_loop);

static int32_t isInit = 0;
static struct k_sem adc_sem;


int32_t adc_send() {
    if (isInit == 0) {
        LOG_INF("ADC loop not initialized");
        return ENOENT;
    }
    k_sem_give(&adc_sem);

    return 0;
}


static void adc_loop(void *p1, void *p2, void *p3)
{

    k_sem_init(&adc_sem, 0, 1);
    if (isInit == 0) {
        isInit = 1;
        LOG_INF("ADC loop initialized");
    }

    while (1) {
        k_timeout_t timeout = K_MSEC(rand() % 100);

        k_sem_take(&adc_sem, timeout);
        LOG_INF("ADC loop running");
        /* Add your LED control code here */
    }
}



K_THREAD_DEFINE(adc_thread, 2*1024, adc_loop, NULL, NULL, NULL, 7, 0, 0);
```

## src/led_loop.c
```c
#include "zephyr/sys/clock.h"
#include <stdlib.h>
#include <sys/_stdint.h>
#include <sys/errno.h>
#include <zephyr/kernel.h>


#include <zephyr/logging/log.h>

LOG_MODULE_REGISTER(led_loop);

static int32_t isInit = 0;
static struct k_sem led_sem;


int32_t led_send() {
    if (isInit == 0) {
        LOG_INF("LED loop not initialized");
        return ENOENT;
    }
    k_sem_give(&led_sem);

    return 0;
}


static void led_loop(void *p1, void *p2, void *p3)
{

    k_sem_init(&led_sem, 0, 1);
    if (isInit == 0) {
        isInit = 1;
        LOG_INF("LED loop initialized");
    }

    while (1) {
        k_timeout_t timeout = K_MSEC(rand() % 100);

        k_sem_take(&led_sem, timeout);
        LOG_INF("LED loop running");
        /* Add your LED control code here */
    }
}



K_THREAD_DEFINE(led_thread, 2*1024, led_loop, NULL, NULL, NULL, 7, 0, 0);
```
